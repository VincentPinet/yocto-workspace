## layers/meta-my-layer/conf/distro/my-distro.conf
```bitbake
DISTRO = "my-distro"
DISTRO_NAME = "My Distro"
DISTRO_VERSION = "0.1.0-unreleased"
MAINTAINER = "me"
```

## layers/meta-my-layer/conf/machine/my-machine.conf
```bitbake
MACHINEOVERRIDES =. "raspberrypi4-64:"
require conf/machine/raspberrypi4-64.conf

# https://meta-raspberrypi.readthedocs.io/en/latest/ipcompliance.html
LICENSE_FLAGS_ACCEPTED = "synaptics-killswitch"

ENABLE_UART = "1"
RPI_USE_U_BOOT = "1"
```
